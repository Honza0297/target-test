## main/Kconfig.projbuild
```kconfig
menu "Target Test Configuration"

    choice TARGET_TEST_INTERFACE
        prompt "Bus to emulate (must match the bridge's BRIDGE_TO_TARGET_INTERFACE)"
        default TARGET_TEST_INTERFACE_SPI
        help
            Select which slave bus this target emulates. It must match the
            interface selected on the esp-usb-bridge side.

        config TARGET_TEST_INTERFACE_SPI
            bool "SPI slave"
        config TARGET_TEST_INTERFACE_I2C
            bool "I2C slave"
        config TARGET_TEST_INTERFACE_UART
            bool "UART"

    endchoice

    config TARGET_TEST_SPI_MOSI
        int "SPI MOSI (D) GPIO pin"
        default 7
        depends on TARGET_TEST_INTERFACE_SPI
        help
            Wire to the bridge's SERIAL_HANDLER_SPI_MOSI pin.

    config TARGET_TEST_SPI_MISO
        int "SPI MISO (Q) GPIO pin"
        default 2
        depends on TARGET_TEST_INTERFACE_SPI
        help
            Wire to the bridge's SERIAL_HANDLER_SPI_MISO pin.

    config TARGET_TEST_SPI_SCLK
        int "SPI SCLK GPIO pin"
        default 6
        depends on TARGET_TEST_INTERFACE_SPI
        help
            Wire to the bridge's SERIAL_HANDLER_SPI_SCLK pin.

    config TARGET_TEST_SPI_CS
        int "SPI CS GPIO pin"
        default 10
        depends on TARGET_TEST_INTERFACE_SPI
        help
            Wire to the bridge's SERIAL_HANDLER_SPI_CS pin.

    config TARGET_TEST_I2C_SDA
        int "I2C SDA GPIO pin"
        default 5
        depends on TARGET_TEST_INTERFACE_I2C
        help
            Wire to the bridge's SERIAL_HANDLER_I2C_SDA pin.

    config TARGET_TEST_I2C_SCL
        int "I2C SCL GPIO pin"
        default 4
        depends on TARGET_TEST_INTERFACE_I2C
        help
            Wire to the bridge's SERIAL_HANDLER_I2C_SCL pin.

    config TARGET_TEST_I2C_ADDR
        hex "I2C slave address (7-bit)"
        default 0x28
        depends on TARGET_TEST_INTERFACE_I2C
        help
            Must match the bridge's SERIAL_HANDLER_I2C_TARGET_ADDR.

    config TARGET_TEST_UART_RX
        int "UART RX GPIO pin"
        default 4
        depends on TARGET_TEST_INTERFACE_UART
        help
            Wire to the bridge's SERIAL_HANDLER_GPIO_TXD pin (bridge TX -> target RX).

    config TARGET_TEST_UART_TX
        int "UART TX GPIO pin"
        default 5
        depends on TARGET_TEST_INTERFACE_UART
        help
            Wire to the bridge's SERIAL_HANDLER_GPIO_RXD pin (target TX -> bridge RX).

    config TARGET_TEST_UART_BAUD
        int "UART baud rate"
        default 115200
        depends on TARGET_TEST_INTERFACE_UART
        help
            Must match the baud rate used by the host terminal (the bridge forwards
            the host's CDC line-coding baud to its UART). The bridge default is 115200.

endmenu
```

## sdkconfig.defaults
```kconfig
CONFIG_IDF_TARGET="esp32c6"

# Console runs over the built-in USB Serial/JTAG, so the test bus pins are free.
CONFIG_ESP_CONSOLE_USB_SERIAL_JTAG=y
```
